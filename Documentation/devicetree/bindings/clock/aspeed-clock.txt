## Documentation/devicetree/bindings/clock/aspeed-clock.txt
```
Device Tree Clock bindings for the Aspeed SoCs

Aspeed SoCs have a fixed frequency input osciallator is used to create the PLL
and APB clocks. We can determine these frequencies by reading registers that
are set according to strapping bits.

Forth generation boards
-----------------------

eg, ast2400.

CLKIN:
 - compatible : Must be "fixed-clock"
 - #clock-cells : Should be 0
 - clock-frequency: 48e6, 25e6 or 24e6 depending on the input clock

PLL:

Required properties:
 - compatible : Must be "aspeed,g4-hpll-clock"
 - #clock-cells : Should be 0
 - reg : Should contain registers location and length
 - clocks : Should contain phandle + clock-specifier for the input clock (clkin)

Optional properties:
 - clock-output-names : Should contain clock name


APB:

Required properties:
 - compatible : Must be "aspeed,g4-apb-clock"
 - #clock-cells : Should be 0
 - reg : Should contain registers location and length
 - clocks : Should contain phandle + clock-specifier for the h-pll

Optional properties:
 - clock-output-names : Should contain clock name


For example:

	clk_clkin: clk_clkin {
		#clock-cells = <0>;
		compatible = "fixed-clock";
		clock-frequency = <48000000>;
	};

	clk_hpll: clk_hpll {
		compatible = "aspeed,g4-hpll-clock";
		#clock-cells = <0>;
		reg = <0x1e6e2008 0x4>;
	};

	clk_apb: clk_apb@1e6e2008 {
		#clock-cells = <0>;
		compatible = "aspeed,g4-apb-clock";
		reg = <0x1e6e2008 0x4>;
		clocks = <&clk_hpll>;
	};



Fifth generation boards
-----------------------

eg, ast2500.

CLKIN:
Required properties:
 - compatible : Must be "fixed-clock"
 - #clock-cells : Should be 0
 - clock-frequency: 25000000 or 24000000 depending on the input clock

H-PLL:

Required properties:
 - compatible : Must be "aspeed,g5-hpll-clock"
 - #clock-cells : Should be 0
 - reg : Should contain registers location and length
 - clocks : Should contain phandle + clock-specifier for the input clock (clkin)

Optional properties:
 - clock-output-names : Should contain clock name


AHB:

Required properties:
 - compatible : Must be "aspeed,g5-ahb-clock"
 - #clock-cells : Should be 0
 - reg : Should contain registers location and length
 - clocks : Should contain phandle + clock-specifier for the the h-pll

Optional properties:
 - clock-output-names : Should contain clock name

APB:

Required properties:
 - compatible : Must be "aspeed,g4-apb-clock"
 - #clock-cells : Should be 0
 - reg : Should contain registers location and length
 - clocks : Should contain phandle + clock-specifier for the the h-pll

Optional properties:
 - clock-output-names : Should contain clock name


For example:
	clk_clkin: clk_clkin@1e6e2070 {
		#clock-cells = <0>;
		compatible = "aspeed,g5-clkin-clock";
		reg = <0x1e6e2070 0x04>;
	};

	clk_hpll: clk_hpll@1e6e2024 {
		#clock-cells = <0>;
		compatible = "aspeed,g5-hpll-clock";
		reg = <0x1e6e2024 0x4>;
		clocks = <&clk_clkin>;
	};

	clk_ahb: clk_ahb@1e6e2070 {
		#clock-cells = <0>;
		compatible = "aspeed,g5-ahb-clock";
		reg = <0x1e6e2070 0x4>;
		clocks = <&clk_hpll>;
	};

	clk_apb: clk_apb@1e6e2008 {
		#clock-cells = <0>;
		compatible = "aspeed,g5-apb-clock";
		reg = <0x1e6e2008 0x4>;
		clocks = <&clk_hpll>;
	};
```

## Documentation/devicetree/bindings/fsi/fsi-master-gpio.txt
```
Device-tree bindings for gpio-based FSI master driver
-----------------------------------------------------

Required properties:
	- compatible = "ibm,fsi-master-gpio";
	- clk-gpios;
	- data-gpios;

Optional properties:
	- enable-gpios;
	- trans-gpios;
	- mux-gpios;

fsi-master {
	compatible = "ibm,fsi-master", "ibm,fsi-master-gpio";
	clk-gpios = <&gpio 0 &gpio 6>;
	data-gpios = <&gpio 1 &gpio 7>;
	enable-gpios = <&gpio 2 &gpio 8>;	/* Enable FSI data in/out */
	trans-gpios = <&gpio 3 &gpio 9>;	/* Volts translator direction */
	mux-gpios = <&gpio 4> &gpio 10>;	/* Multiplexer for FSI pins */
}
```

## Documentation/devicetree/bindings/fsi/ibm,fsi2spi.yaml
```yaml
# SPDX-License-Identifier: (GPL-2.0-or-later)
%YAML 1.2
---
$id: http://devicetree.org/schemas/fsi/ibm,fsi2spi.yaml#
$schema: http://devicetree.org/meta-schemas/core.yaml#

title: IBM FSI-attached SPI controllers

maintainers:
  - Eddie James <eajames@linux.ibm.com>

description: |
  This binding describes an FSI CFAM engine called the FSI2SPI. Therefore this
  node will always be a child of an FSI CFAM node; see fsi.txt for details on
  FSI slave and CFAM nodes. This FSI2SPI engine provides access to a number of
  SPI controllers.

properties:
  compatible:
    enum:
      - ibm,fsi2spi

  reg:
    items:
      - description: FSI slave address

patternProperties:
  "^spi(@.*|-[0-9a-f])*$":
    type: object

    properties:
      fsi2spi,restricted:
        description: indicates the controller should not use looping in the
          sequencer and therefore has a smaller maximum transfer size
        type: boolean

required:
  - compatible
  - reg

examples:
  - |
    fsi2spi@1c00 {
        compatible = "ibm,fsi2spi";
        reg = <0x1c00 0x400>;
    };
```

## Documentation/devicetree/bindings/fsi/ibm,p9-occ-hwmon.txt
```
Device-tree bindings for FSI-based On-Chip Controller hwmon device
------------------------------------------------------------------

Required properties:
 - compatible = "ibm,p9-occ-hwmon";

Examples:

    occ@1 {
        compatible = "ibm,p9-occ";
        reg = <1>;

        occ-hwmon@1 {
            compatible = "ibm,p9-occ-hmwon";
        }
    };
```

## Documentation/devicetree/bindings/fsi/ibm,p9-occ.txt
```
Device-tree bindings for P9 On-Chip Controller
----------------------------------------------

The POWER9 On-Chip Controller is accessed through the SBEFIFO. All OCC nodes
must be child nodes of SBEFIFO devices (see ibm,p9-sbefifo.txt).

Required properties:
 - compatible = "ibm,p9-occ";

Optional properties:
 - reg = <processor index>;	: Index for the processor this OCC is on.

Examples:

    occ@1 {
        compatible = "ibm,p9-occ";
        reg = <1>;
    };
```

## Documentation/devicetree/bindings/fsi/ibm,p9-sbefifo.txt
```
Device-tree bindings for P9 SBEFIFO CFAM device
-----------------------------------------------

Required properties:
 - compatible = "ibm,p9-sbefifo";
 - reg = < address size >;		: FSI CFAM address for the SBE engine
					  and address space size.
 - #address-cells = <1>;		: Number of address cells in child
					  nodes.
 - #size-cells = <0>;			: Number of size cells in child nodes.

Optional properties:
 - <child nodes>			: Devices that are accessible through
					  the SBEFIFO. Child nodes are "opaque"
					  to the SBEFIFO; the SBEFIFO needs no
					  information about a child node other
					  than if it exists or not.

Child node optional properties:
 - compatible = "dts-name"
 - reg = < address >;			: Meaningful only for the child node

Examples:

    sbefifo@2400 {
        compatible = "ibm,p9-sbefifo";
        reg = < 0x2400 0x400 >;
        #address-cells = <1>;
        #size-cells = <0>;

        occ@1 {
            compatible = "ibm,p9-occ";
            reg = < 1 >;
        };
    };
```

## Documentation/devicetree/bindings/hwmon/adm1275.txt
```
adm1275 temperature sensor
--------------------------

Required property:

 - compatible: "adi,adm1278"
 - reg: i2c device address 

Optional property:

- sense-resistor: external sense resistor value in milliOhms

Example:

sensor { 
	reg = <0x11>;
	compatible = "adi,adm1278";
	sense-resistor = < 100 >
}
```

## Documentation/devicetree/bindings/hwmon/maxim,max6639.yaml
```yaml
# SPDX-License-Identifier: (GPL-2.0 OR BSD-2-Clause)
%YAML 1.2
---

$id: http://devicetree.org/schemas/hwmon/maxim,max6639.yaml#
$schema: http://devicetree.org/meta-schemas/core.yaml#

title: Maxim max6639

maintainers:
  - Roland Stigge <stigge@antcom.de>

description: |
  The MAX6639 is a 2-channel temperature monitor with dual, automatic, PWM
  fan-speed controller.  It monitors its own temperature and one external
  diode-connected transistor or the temperatures of two external diode-connected
  transistors, typically available in CPUs, FPGAs, or GPUs.

  Datasheets:
    https://datasheets.maximintegrated.com/en/ds/MAX6639-MAX6639F.pdf

properties:
  compatible:
    enum:
      - maxim,max6639

  reg:
    maxItems: 1

  '#address-cells':
    const: 1

  '#size-cells':
    const: 0

required:
  - compatible
  - reg
  - "channel@0"
  - "channel@1"

additionalProperties: false

patternProperties:
  "^channel@[0-1]$":
    type: object
    description: |
      Represents the two fans and their specific configuration.

    properties:
      reg:
        description: |
          The fan number.
        items:
          minimum: 0
          maximum: 1

      pwm-polarity:
        $ref: /schemas/types.yaml#/definitions/uint32
        enum: [0, 1]
        description:
          PWM output is low at 100% duty cycle when this bit is set to zero. PWM
          output is high at 100% duty cycle when this bit is set to 1.

      pulses-per-revolution:
        $ref: /schemas/types.yaml#/definitions/uint32
        enum: [1, 2, 3, 4]
        description:
          Value specifying the number of pulses per revolution of the controlled
          FAN.

      rpm-range:
        $ref: /schemas/types.yaml#/definitions/uint32
        enum: [2000, 4000, 8000, 16000]
        description:
          Scales the tachometer counter by setting the maximum (full-scale) value
          of the RPM range.

    required:
      - reg
      - pwm-polarity
      - pulses-per-revolution
      - rpm-range

examples:
  - |
    i2c {
      #address-cells = <1>;
      #size-cells = <0>;

      max6639@10 {
        compatible = "maxim,max6639";
        reg = <0x10>;
        #address-cells = <1>;
        #size-cells = <0>;

        channel@0 {
          reg = <0x0>;
          pwm-polarity = <1>;
          pulses-per-revolution = <2>;
          rpm-range = <4000>;
        };

        channel@1 {
          reg = <0x1>;
          pwm-polarity = <1>;
          pulses-per-revolution = <2>;
          rpm-range = <4000>;
        };
      };
    };
...
```

## Documentation/devicetree/bindings/i2c/i2c-aspeed.txt
```
Device tree configuration for the I2C controller and busses on the AST24XX
and AST25XX SoCs.

Controller:

	Required Properties:
	- #address-cells	: should be 1
	- #size-cells 		: should be 1
	- #interrupt-cells 	: should be 1
	- compatible 		: should be "aspeed,ast2400-i2c-controller"
				  or "aspeed,ast2500-i2c-controller"
	- reg			: address start and range of controller
	- ranges		: defines address offset and range for busses
	- interrupts		: interrupt number
	- clocks		: root clock of bus, should reference the APB
				  clock
	- clock-ranges		: specifies that child busses can inherit clocks
	- interrupt-controller	: denotes that the controller receives and fires
				  new interrupts for child busses

Bus:

	Required Properties:
	- #address-cells	: should be 1
	- #size-cells		: should be 0
	- reg			: address offset and range of bus
	- compatible		: should be "aspeed,ast2400-i2c-bus"
				  or "aspeed,ast2500-i2c-bus"
	- interrupts		: interrupt number

	Optional Properties:
	- clock-frequency	: frequency of the bus clock in Hz
				  defaults to 100 kHz when not specified

Example:

i2c: i2c@1e78a000 {
	#address-cells = <1>;
	#size-cells = <1>;
	#interrupt-cells = <1>;

	compatible = "aspeed,ast2400-i2c-controller";
	reg = <0x1e78a000 0x40>;
	ranges = <0 0x1e78a000 0x1000>;
	interrupts = <12>;
	clocks = <&clk_apb>;
	clock-ranges;
	interrupt-controller;

	i2c0: i2c-bus@40 {
		#address-cells = <1>;
		#size-cells = <0>;
		reg = <0x40 0x40>;
		compatible = "aspeed,ast2400-i2c-bus";
		clock-frequency = <100000>;
		status = "disabled";
		interrupts = <0>;
		interrupt-parent = <&i2c>;
	};
};
```

## Documentation/devicetree/bindings/i2c/i2c-fsi.txt
```
IBM FSI-attached I2C master
=========================

IBM Power8 and Power9 server CPUs have I2C masters inside their CFAM pervasive
logic. This same hardware is present in the Power8 Centaur SDRAM buffer chips,
but this is not yet described by this binding.

These can be accessed over the FSI bus using CFAM operations. This binding
describes the I2C masters on the FSI bus.

The I2C master is a child of the fsi slave, a bus internal to the Power CPU:

 - compatible: must be one of
                - ibm,power8-i2cm
                - ibm,power9-i2cm
 - address cells: must be 1
 - size-cells: must be 0
 - bus-frequency: the I2C master's input clock frequency in Hz
 - reg: two cells, the first containing the offset in the SCOM engine for the
   i2c master.

The I2C bus is a child of a I2C master:

 - compatible: must be one of
                - ibm,power8-i2c-port
                - ibm,power9-i2c-port
 - address cells: must be 0
 - size-cells: must be 0
 - clock-frequency: the i2c clock rate
 - reg: one cell, showing the number of this bus. Commonly there is only one,
   so this is zero.

Children of the I2C bus is described by the i2c binding.

Example:

fsi_clock {
        #clock-cells = <0>;
        compatible = "fixed-clock";
        clock-frequency = <125000000>;
}

fsi-slave-engine@0 {
        #address-cells = <1>;
        #size-cells = <0>;
        compatible = "ibm,fsi", "ibm,power8-fsi";
        reg = <0x0>;

        i2cm@a0000 {
                        #address-cells = <1>;
                        #size-cells = <0>;
                        compatible = "ibm,power8-i2cm";
                        reg = <0x000a0000>;
                        clocks = <&fsi_clock>;

                        i2c-bus@0 {
                                #address-cells = <0x1>;
                                #size-cells = <0x0>;
                                clock-frequency = <400000>;
                                compatible = "ibm,power8-i2c-port";

                                reg = <0x0>;
                        };
                };
        };
}
```

## Documentation/devicetree/bindings/i2c/i2c-ibm-occ.txt
```
HWMON i2c driver for IBM POWER CPU OCC (On Chip Controller)

Required properties:
 - compatible: must be "ibm,power8-occ-i2c"
 - reg: physical address

Example:
i2c3: i2c-bus@100 {
	occ@50 {
		compatible = "ibm,occ-i2c";
		reg = <0x50>;
	};
};
```

## Documentation/devicetree/bindings/i2c/ibm,power-ps.txt
```
Device-tree bindings for IBM POWER system power supplies
--------------------------------------------------------

Required properties:
 - compatible = "ibm,power-ps";
 - reg = < I2C bus address >;		: Address of the power supply on the
					  I2C bus.

Example:

    i2c-bus@100 {
        #address-cells = <1>;
        #size-cells = <0>;
        #interrupt-cells = <1>;
        < more properties >

        power_ps@68 {
            compatible = "ibm,power-ps";
            reg = <0x68>;
        };
    };
```

## Documentation/devicetree/bindings/interrupt-controller/aspeed,ast2400-i2c-ic.txt
```
Device tree configuration for the I2C Interrupt Controller on the AST24XX and
AST25XX SoCs.

Required Properties:
- #address-cells	: should be 1
- #size-cells 		: should be 1
- #interrupt-cells 	: should be 1
- compatible 		: should be "aspeed,ast2400-i2c-ic"
			  or "aspeed,ast2500-i2c-ic"
			  or "aspeed,ast2600-i2c-ic"
- reg			: address start and range of controller
- interrupts		: interrupt number
- interrupt-controller	: denotes that the controller receives and fires
			  new interrupts for child busses

Optional Properties:
- bus-owner		: aspeed individual i2c bus can controllerd by different
			  processor, including interrupt report owner, each bit
			  present each i2c bus number owner, 0: assigned to ARM,
			  1: assigned to Coprocessor in SoC

Example:

i2c_ic: interrupt-controller@0 {
	#address-cells = <1>;
	#size-cells = <1>;
	#interrupt-cells = <1>;
	compatible = "aspeed,ast2400-i2c-ic";
	reg = <0x0 0x40>;
	interrupts = <12>;
	interrupt-controller;
};
```
