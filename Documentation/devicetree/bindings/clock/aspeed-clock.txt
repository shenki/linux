## Documentation/devicetree/bindings/interrupt-controller/aspeed,ast2400-vic.txt
```
Aspeed Vectored Interrupt Controller

These bindings are for the Aspeed AST2400 interrupt controller register layout.
The SoC has an legacy register layout, but this driver does not support that
mode of operation.

Required properties:

- compatible : should be "aspeed,ast2400-vic".

- interrupt-controller : Identifies the node as an interrupt controller
- #interrupt-cells : Specifies the number of cells needed to encode an
  interrupt source. The value shall be 1.
- valid-sources : bitmask of valid irq sources

Example:

 vic: interrupt-controller {
      compatible = "aspeed,ast2400-new-vic";
      interrupt-controller;
      #interrupt-cells = <1>;
      valid-sources = < 0xffffffff 0x0007ffff>;
      reg = <0x1e6c0080 0x80>;
 };
```

## Documentation/devicetree/bindings/mfd/max5970.yaml
```yaml
# SPDX-License-Identifier: (GPL-2.0 OR BSD-2-Clause)
%YAML 1.2
---
$id: http://devicetree.org/schemas/mfd/max5970.yaml#
$schema: http://devicetree.org/meta-schemas/core.yaml#

title: Regulator driver for MAX5970 smart switch from Maxim Integrated.

maintainers:
  - Patrick Rudolph <patrick.rudolph@9elements.com>

description: |
  The smart switch provides no output regulation, but independent fault protection
  and voltage and current sensing.
  Programming is done through I2C bus.

  Datasheets:
    https://datasheets.maximintegrated.com/en/ds/MAX5970.pdf
    https://datasheets.maximintegrated.com/en/ds/MAX5978.pdf

properties:
  compatible:
    enum:
      - maxim,max5970
      - maxim,max5978

  reg:
    maxItems: 1

  interrupts:
    maxItems: 1

  leds:
    type: object
    description:
      Properties for single channel.

    patternProperties:
      "^led@[0-3]$":
        $ref: /schemas/leds/common.yaml#
        type: object

    additionalProperties: true

  vss1-supply:
    description: Supply of the first channel.

  "#io-channel-cells":
    const: 1

  regulators:
    type: object
    description:
      Properties for single channel.

    patternProperties:
      "^(sw[0-1])$":
        $ref: /schemas/regulator/regulator.yaml#
        type: object

      shunt-resistor-micro-ohms:
        description: |
          The value of curent sense resistor in microohms.
          Must be specified for each channel.

    additionalProperties: true

required:
  - compatible
  - reg
  - regulators
  - vss1-supply

allOf:
  - $ref: /schemas/regulator/regulator.yaml#
  - if:
      properties:
        compatible:
          enum:
            - maxim,max5970
    then:
      properties:
        vss2-supply:
          description: Supply of the second channel.

        io-channels:
          items:
            - description: voltage first channel
            - description: current first channel
            - description: voltage second channel
            - description: current second channel
          description: |
            Voltage and current for first and second channel.
      required:
        - vss2-supply

    else:
      properties:
        io-channels:
          items:
            - description: voltage first channel
            - description: current first channel
          description: |
            Voltage and current for first channel.

additionalProperties: false

examples:
  - |
    i2c {
            #address-cells = <1>;
            #size-cells = <0>;
            leds {
                #address-cells = <1>;
                #size-cells = <0>;
                led@0 {
                        reg = <0>;
                        label = "led0";
                        default-state = "on";
                };
                led@1 {
                        reg = <1>;
                        label = "led1";
                        default-state = "on";
                };
            };
            regulator@3a {
                    reg = <0x3a>;
                    vss1-supply = <&p3v3>;
                    compatible = "maxim,max5978";

                    regulators {
                            sw0_ref_0: SW0 {
                                   regulator-compatible = "SW0";
                                   shunt-resistor-micro-ohms = <12000>;
                            };
                    };
            };
    };

  - |
    i2c {
            #address-cells = <1>;
            #size-cells = <0>;

            regulator@3a {
                    reg = <0x3a>;
                    vss1-supply = <&p3v3>;
                    vss2-supply = <&p5v>;
                    compatible = "maxim,max5970";

                    regulators {
                            sw0_ref_1: SW0 {
                                   regulator-compatible = "SW0";
                                   shunt-resistor-micro-ohms = <12000>;
                            };
                            sw1_ref_1: SW1 {
                                   regulator-compatible = "SW1";
                                   shunt-resistor-micro-ohms = <10000>;
                            };
                    };
            };
    };
...
```

## Documentation/devicetree/bindings/mtd/aspeed-smc.txt
```
* Aspeed Static Memory controller in SPI mode
* Aspeed SPI Flash Controller

Required properties:
  - compatible : Should be one of
	"aspeed,ast2400-fmc" for the AST2400 Static Memory Controller
	"aspeed,ast2500-fmc" for the AST2500 Static Memory Controller
	"aspeed,ast2400-smc" for the AST2400 SPI flash controller
  - reg : the first contains the register location and length,
          the second through nth contains the memory mapping address and length
	  for the access window for each chips select
  - interrupts : Should contain the interrupt for the dma device if fmc
  - clocks : The APB clock input to the controller
  - #address-cells : must be 1 corresponding to chip select child binding
  - #size-cells : must be 0 corresponding to chip select child binding


Child node required properties:
  - reg : must contain chip select number in first cell of address, must
	  be 1 tuple long
  - compatible : may contain "vendor,part", must include "jedec,spi-nor"
		(see spi-nor.txt binding).

Child node optional properties:
  - label           - (optional) name to assign to mtd, default os assigned
  - spi-max-frequency - (optional) max frequency of spi bus (XXX max if missing)
  - spi-cpol        - (optional) Empty property indicating device requires
    	 		inverse clock polarity (CPOL) mode (boolean)
  - spi-cpha        - (optional) Empty property indicating device requires
    			shifted clock phase (CPHA) mode (boolean)
  - spi-tx-bus-width - (optional) The bus width(number of data wires) that
                        used for MOSI. Defaults to 1 if not present.
  - spi-rx-bus-width - (optional) The bus width(number of data wires) that
                        used for MOSI. Defaults to 1 if not present.

Child node optional properties:
 - see mtd/partiton.txt for partitioning bindings and mtd naming


Example:

fmc: fmc@1e620000 {
	compatible = "aspeed,ast2400-fmc";
	reg = < 0x1e620000 0x94
		0x20000000 0x02000000
		0x22000000 0x02000000 >;
	#address-cells = <1>;
	#size-cells = <0>;
	flash@0 {
		reg = < 0 >;
		compatible = "jedec,spi-nor" ;
		label = "bmc";
		/* spi-max-frequency = <>; */
		/* m25p,fast-read; */
		#address-cells = <1>;
		#size-cells = <1>;
		boot@0 {
			label = "boot-loader";
			reg = < 0 0x8000 >
		}
		image@8000 {
			label = "kernel-image";
			reg = < 0x8000 0x1f8000 >
		}
	};
	flash@1 {
		reg = < 1 >;
		compatible = "jedec,spi-nor" ;
		label = "alt";
		/* spi-max-frequency = <>; */
		status = "fail";
		/* m25p,fast-read; */
	};
};
```

## Documentation/devicetree/bindings/pinctrl/pinctrl-aspeed.txt
```
Aspeed Pin Controllers
----------------------

The Aspeed SoCs vary in functionality inside a generation but have a common mux
device register layout.

Required properties:
- compatible : should be one of the following:
		"aspeed,ast2400-pinctrl"
		"aspeed,g4-pinctrl";
		"aspeed,ast2500-pinctrl"
		"aspeed,g5-pinctrl"

The pin controller node should be a child of a syscon node with the required
property:
- compatible: "syscon", "simple-mfd"

Refer to the the bindings described in
Documentation/devicetree/bindings/mfd/syscon.txt

Subnode Format
--------------

The required properties of child nodes are (as defined in pinctrl-bindings):
- function
- groups

Each function has only one associated pin group. Each group is named by its
function. The following values for the function and groups properties are
supported:

aspeed,ast2400-pinctrl, aspeed,g4-pinctrl:

  ACPI BMCINT DDCCLK DDCDAT FLACK FLBUSY FLWP GPID0 GPIE0 I2C3 I2C4 I2C5 I2C6
  I2C7 I2C8 I2C9 I2C10 I2C11 I2C12 I2C13 LPCPD LPCSMI MDIO2 NCTS1 NCTS3 NCTS4
  NDCD1 NDCD3 NDCD4 NDSR1 NDTR1 NRI1 NRI4 NRTS1 PWM0 PWM1 PWM2 PWM3 PWM4 PWM5
  PWM6 PWM7 RGMII1 RMII1 ROM16 ROM8 RXD1 RXD4 SD1 SGPMI SIOPBI SIOPBO TIMER3
  TIMER5 TIMER6 TIMER7 TIMER8 TXD1 TXD4 UART6 VGAHS VGAVS VPI18 VPI24 VPI30
  VPO12 VPO24

aspeed,ast2500-pinctrl, aspeed,g5-pinctrl:

  GPID0 GPID1 I2C3 I2C4 I2C5 I2C6 I2C7 I2C8 I2C9 I2C10 I2C11 I2C12 I2C13 I2C14
  MDIO1 PWM0 PWM1 PWM2 PWM3 PWM4 PWM5 PWM6 PWM7 RGMII1 RMII1 RGMII2 RMII2 SD1

Examples:

syscon: scu@1e6e2000 {
	compatible = "syscon", "simple-mfd";
	reg = <0x1e6e2000 0x1a8>;

	pinctrl: pinctrl@1e6e2000 {
		compatible = "aspeed,g4-pinctrl";

		pinctrl_i2c3_default: i2c3_default {
			function = "I2C3";
			groups = "I2C3";
		};
	};
};

Please refer to pinctrl-bindings.txt in this directory for details of the
common pinctrl bindings used by client devices.
```

## Documentation/devicetree/bindings/watchdog/aspeed-wdt.txt
```
Aspeed Watchdog Timer

Required properties:
 - compatible: must be "aspeed,wdt"
 - reg: physical base address of the controller and length of memory mapped
   region

Example:

	wdt1: wdt@1e785000 {
		compatible = "aspeed,wdt";
		reg = <0x1e785000 0x1c>;
		interrupts = <27>;
	};
```

## arch/arm/configs/ast2500_evb_defconfig
```kconfig
# CONFIG_LOCALVERSION_AUTO is not set
CONFIG_KERNEL_LZO=y
CONFIG_SYSVIPC=y
CONFIG_USELIB=y
CONFIG_NO_HZ_IDLE=y
CONFIG_HIGH_RES_TIMERS=y
CONFIG_LOG_BUF_SHIFT=14
CONFIG_BLK_DEV_INITRD=y
CONFIG_INITRAMFS_SOURCE="/home/joel/broomstick.cpio.xz"
CONFIG_MODULES=y
CONFIG_MODULE_FORCE_LOAD=y
CONFIG_MODULE_UNLOAD=y
CONFIG_MODULE_FORCE_UNLOAD=y
# CONFIG_BLK_DEV_BSG is not set
CONFIG_PARTITION_ADVANCED=y
CONFIG_ARCH_ASPEED=y
CONFIG_ARCH_AST2500=y
CONFIG_AEABI=y
# CONFIG_CPU_SW_DOMAIN_PAN is not set
CONFIG_USE_OF=y
# CONFIG_ATAGS is not set
CONFIG_ZBOOT_ROM_TEXT=0x0
CONFIG_ZBOOT_ROM_BSS=0x0
CONFIG_ARM_APPENDED_DTB=y
CONFIG_ARM_ATAG_DTB_COMPAT=y
CONFIG_VFP=y
# CONFIG_SUSPEND is not set
CONFIG_NET=y
CONFIG_PACKET=y
CONFIG_UNIX=y
CONFIG_INET=y
CONFIG_IP_MULTICAST=y
CONFIG_IP_PNP=y
CONFIG_IP_PNP_DHCP=y
CONFIG_IP_PNP_BOOTP=y
CONFIG_IP_PNP_RARP=y
CONFIG_NET_IPIP=y
# CONFIG_INET_XFRM_MODE_TRANSPORT is not set
# CONFIG_INET_XFRM_MODE_TUNNEL is not set
# CONFIG_INET_XFRM_MODE_BEET is not set
# CONFIG_IPV6 is not set
CONFIG_UEVENT_HELPER_PATH="/sbin/hotplug"
CONFIG_DEVTMPFS=y
CONFIG_DEVTMPFS_MOUNT=y
CONFIG_MTD=y
CONFIG_MTD_CMDLINE_PARTS=y
CONFIG_MTD_BLOCK=y
CONFIG_MTD_DATAFLASH=y
CONFIG_MTD_M25P80=y
CONFIG_MTD_SST25L=y
CONFIG_MTD_BLOCK2MTD=y
CONFIG_MTD_SPI_NOR=y
CONFIG_BLK_DEV_LOOP=y
CONFIG_BLK_DEV_RAM=y
CONFIG_BLK_DEV_RAM_SIZE=16384
CONFIG_SCSI=y
CONFIG_BLK_DEV_SD=y
CONFIG_CHR_DEV_SG=y
CONFIG_SCSI_SCAN_ASYNC=y
CONFIG_NETDEVICES=y
CONFIG_BONDING=y
# CONFIG_NET_VENDOR_AST is not set
# CONFIG_NET_VENDOR_AMAZON is not set
# CONFIG_NET_VENDOR_ARC is not set
# CONFIG_NET_CADENCE is not set
# CONFIG_NET_VENDOR_BROADCOM is not set
# CONFIG_NET_VENDOR_CIRRUS is not set
# CONFIG_NET_VENDOR_EZCHIP is not set
# CONFIG_NET_VENDOR_FARADAY is not set
# CONFIG_NET_VENDOR_HISILICON is not set
# CONFIG_NET_VENDOR_INTEL is not set
# CONFIG_NET_VENDOR_MICREL is not set
# CONFIG_NET_VENDOR_MICROCHIP is not set
# CONFIG_NET_VENDOR_NATSEMI is not set
# CONFIG_NET_VENDOR_NETRONOME is not set
# CONFIG_NET_VENDOR_QUALCOMM is not set
# CONFIG_NET_VENDOR_RENESAS is not set
# CONFIG_NET_VENDOR_ROCKER is not set
# CONFIG_NET_VENDOR_SAMSUNG is not set
# CONFIG_NET_VENDOR_SEEQ is not set
# CONFIG_NET_VENDOR_SMSC is not set
# CONFIG_NET_VENDOR_STMICRO is not set
# CONFIG_NET_VENDOR_SYNOPSYS is not set
# CONFIG_NET_VENDOR_VIA is not set
# CONFIG_NET_VENDOR_WIZNET is not set
# CONFIG_WLAN is not set
# CONFIG_INPUT_MOUSEDEV is not set
# CONFIG_INPUT_KEYBOARD is not set
# CONFIG_INPUT_MOUSE is not set
# CONFIG_SERIO_SERPORT is not set
CONFIG_SERIO_AMBAKMI=y
CONFIG_SERIO_LIBPS2=y
CONFIG_VT_HW_CONSOLE_BINDING=y
CONFIG_LEGACY_PTY_COUNT=16
CONFIG_SERIAL_8250=y
# CONFIG_SERIAL_8250_DEPRECATED_OPTIONS is not set
CONFIG_SERIAL_8250_CONSOLE=y
CONFIG_SERIAL_8250_NR_UARTS=6
CONFIG_SERIAL_8250_RUNTIME_UARTS=6
CONFIG_SERIAL_8250_EXTENDED=y
CONFIG_SERIAL_8250_MANY_PORTS=y
CONFIG_SERIAL_8250_SHARE_IRQ=y
CONFIG_SERIAL_OF_PLATFORM=y
CONFIG_HW_RANDOM=y
# CONFIG_HW_RANDOM_AST is not set
CONFIG_I2C=y
CONFIG_I2C_CHARDEV=y
CONFIG_SPI=y
CONFIG_SPI_FMC=y
CONFIG_GPIOLIB=y
CONFIG_GPIO_SYSFS=y
CONFIG_WATCHDOG=y
CONFIG_ASPEED_WATCHDOG=y
CONFIG_MFD_SYSCON=y
# CONFIG_HID_GENERIC is not set
CONFIG_MMC=y
CONFIG_MMC_SDHCI=y
CONFIG_MMC_SDHCI_PLTFM=y
# CONFIG_IOMMU_SUPPORT is not set
CONFIG_MEMORY=y
CONFIG_EXT2_FS=y
CONFIG_EXT2_FS_XATTR=y
CONFIG_EXT2_FS_POSIX_ACL=y
CONFIG_EXT2_FS_SECURITY=y
# CONFIG_MANDATORY_FILE_LOCKING is not set
CONFIG_VFAT_FS=y
CONFIG_TMPFS=y
CONFIG_TMPFS_POSIX_ACL=y
# CONFIG_MISC_FILESYSTEMS is not set
CONFIG_NLS_CODEPAGE_437=y
CONFIG_NLS_CODEPAGE_950=y
CONFIG_NLS_ISO8859_1=y
CONFIG_DEBUG_INFO=y
CONFIG_DEBUG_INFO_REDUCED=y
CONFIG_DEBUG_INFO_DWARF4=y
CONFIG_GDB_SCRIPTS=y
# CONFIG_ENABLE_WARN_DEPRECATED is not set
# CONFIG_ENABLE_MUST_CHECK is not set
# CONFIG_SECTION_MISMATCH_WARN_ONLY is not set
CONFIG_DEBUG_KERNEL=y
# CONFIG_FTRACE is not set
# CONFIG_ARM_UNWIND is not set
CONFIG_DEBUG_LL=y
CONFIG_DEBUG_LL_UART_8250=y
CONFIG_DEBUG_UART_PHYS=0x1e784000
CONFIG_DEBUG_UART_VIRT=0xf8184000
CONFIG_EARLY_PRINTK=y
```
