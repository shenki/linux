## drivers/fsi/Kconfig
```kconfig
#
# FSI subsystem
#

menu "FSI support"

config FSI
	tristate "FSI support"
	---help---
	  FSI - the FRU Support Interface - is a simple bus for low-level
	  access to POWER-based hardware.

if FSI

config FSI_MASTER_FAKE
	tristate "Fake FSI master"
	depends on FSI
	---help---
	This option enables a fake FSI master driver for debugging.

config FSI_MASTER_GPIO
	tristate "GPIO-based FSI master"
	depends on FSI
	depends on GPIOLIB
	---help---
	This option enables a FSI master driver using GPIO lines.

config FSI_SCOM
	tristate "SCOM FSI client device driver"
	depends on FSI
	---help---
	This option enables an FSI based SCOM device driver.

config FSI_MBX
	tristate "Mailbox FSI client device driver"
	depends on FSI
	---help---
	This option enables an FSI based Mailbox device driver.

endif

endmenu
```

## drivers/net/ethernet/hpe/Kconfig
```kconfig
config NET_VENDOR_HPE
	bool "HPE device"
	default y
	depends on ARCH_HPE
	help
	  HPE ethernet devices

if NET_VENDOR_HPE

config GXP_UMAC
	tristate "GXP UMAC support"
	depends on ARCH_HPE
	select CRC32
	select MII
	select PHYLIB
	select GXP_UMAC_MDIO
	help
	  Support GXP UMAC

config GXP_UMAC_MDIO
	tristate "GXP UMAC mdio support"
	depends on ARCH_HPE
	help
	  Support GXP UMAC mdio bus

endif
```

## drivers/pinctrl/aspeed/Kconfig
```kconfig
config PINCTRL_ASPEED
	bool
	depends on (ARCH_ASPEED || COMPILE_TEST) && OF
	select PINMUX
	select PINCONF
	select GENERIC_PINCONF
	select MFD_SYSCON
	select REGMAP_MMIO

config PINCTRL_ASPEED_G4
	bool "Aspeed AST G4 SoC pin control"
	depends on (MACH_ASPEED_G4 || COMPILE_TEST) && OF
	select PINCTRL_ASPEED
	help
	  Say Y here to enable pin controller support for Aspeed's 4th
	  generation AST SoCs. GPIO is provided by a separate GPIO driver.
```

## drivers/soc/aspeed/Kconfig
```kconfig
#
# MISC configuration for ASPEED SOCs
#

if ARCH_ASPEED
menuconfig ASPEED_MISC
	tristate 'ASPEED SOCs MISC drivers'
	help
	  We can select misc drivers for ASPEED SOC in this sub-function.

if ASPEED_MISC

config AST_VGAVIDEO
	tristate "VGA Video Engine driver"

config AST_VIDEO
	tristate "ASPEED Video Engine driver"
	default n
	help
	  Driver for AST Video Engine 

# Support LPC
config AST_LPC
	bool "AST LPC Driver"

if AST_LPC

choice
	prompt "AST LPC Mode"

config AST_LPC_SLAVE
	bool "Slave"

config AST_LPC_MASTER
	bool "Master"

endchoice

config AST_PCIE2LPC
	bool "AST PCIe2LPC"

config ARCH_AST1070
	depends on AST_LPC_MASTER
	select AST1070_UART_DMA
	bool "AST1070 Comapnion Chip Combination"

config AST_SNOOP
	depends on !AST_LPC_MASTER
	bool "AST SNOOP"

config AST_SNOOP_DMA
	depends on !AST_LPC_MASTER
	bool "AST SNOOP DMA"

config AST_IPMI_KCS
	depends on !AST_LPC_MASTER
	bool "AST IPMI KCS"

config AST_IPMI_BT
	depends on !AST_LPC_MASTER
	bool "AST IPMI BT"

endif 

config ASPEED_ESPI
	tristate "ASPEED eSPI"

if AST_ESPI

config COLDFIRE_ESPI
	bool "Coldfire ESPI"

endif
	
config ADC_CAT9883
	tristate "CAT 9883 ADC driver"
	default n
	help
	  Driver for CAT 9883

config ASPEED_PECI
	tristate "ASPEED PECI Controller"
	default n
	help
	  Driver for PECI Controller

config AST_MBX
	tristate 'ASPEED MailBox support'
	help
	  Support for the Mailbox on the ASPEED chips.

config AST_GPIO
	tristate "ASPEED GPIO Controller"
	default n
	help
	  Driver for GPIO Controller included in ASPEED SOCs.

config AST_JPEG
	tristate "ASPEED JPEG Controller"
	default n
	help
	  Driver for JPEG Controller

config ASPEED_JTAG
	tristate "ASPEED JTAG Controller"
	default n
	help
	  Driver for JTAG Controller

config ASPEED_MCTP
	tristate "ASPEED MCTP Driver"
	depends on !(PCI)
	default n
	help
	  Driver for MCTP

config ASPEED_XDMA
	tristate "ASPEED XDMA Driver"
	default n
	help
	  Driver for XDMA

config AST_VHUB
	tristate "ASPEED VHUB Driver"
	depends on !(USB)
	default n
	help 
	  Driver for VHUB

config AST_HID
	tristate "ASPEED HID Driver"
	depends on !(USB)
	default n
	help 
	  Driver for HID (phase out)

config AST_CRYPTO
	tristate "ASPEED Crypto Driver"
	
config AST_RFX
	tristate "ASPEED RFX Driver"
        default n
        help
          Driver for RFX

config AST_ENTROPY
	tristate "ASPEED Entropy Driver"
	depends on AST_RFX

config AST_BULK
        tristate "ASPEED BULK Driver"
        depends on AST_RFX

config AST_CMDQ
        tristate "ASPEED CMDQ Driver"
        depends on AST_RFX

config AST_BITBLT
        tristate "ASPEED BITBLT Driver"
        depends on AST_RFX

config AST_RLE
	tristate "ASPEED RLE Driver"
	depends on AST_RFX

config AST_EGFX
        tristate "ASPEED EGFX Driver"
        depends on AST_RFX

config AST_MASK
        tristate "ASPEED MASK Driver"
	depends on AST_RFX

config AST_H264
	tristate "ASPEED H.264 Driver"

config AST_FORMATTER
	tristate "ASPEED Formatter Driver"

endif	# CONFIG_AST_MISC
endif	# CONFIG_AST
```

## drivers/usb/gadget/udc/ast_hub_multi_dev/Kconfig
```kconfig
config AST_USB_HUB_MULTI_DEV
        boolean "ASpeed AST Multi Hub device support"
	depends on ARCH_ASPEED
        select USB_GADGET_SELECTED
        select USB_GADGET_DUALSPEED
	help
		This option adds the HUB and multi devices behind
		the HUB for the AST2500.
		
```
